## build/Kconfig
```kconfig
mainmenu "PRM Bootloader 0.01 (NEST)"

menu "Manufacturer and Chip"
source ../platform/Kconfig
endmenu

menu "Complier"
choice
    prompt "Complier"
    config TOOLCHAIN_ARM_NONE_EABI
    bool "arm-none-eabi-gcc"
    depends on TARGET_ARM

    config TOOLCHAIN_ARM_LINUX
    bool "arm-linux-gcc"
    depends on TARGET_ARM
endchoice

source "Kconfig.in"
endmenu

menu "Shell"
source ../shell/Kconfig
endmenu

menu "Ethernet"
source ../ethernet/Kconfig
endmenu
```

## build/Kconfig.in
```kconfig
config TOOLCHAIN_TYPE
string
default arm-none-eabi-
depends on TOOLCHAIN_ARM_NONE_EABI

config TOOLCHAIN_TYPE
string
default arm-linux-
depends on TOOLCHAIN_ARM_LINUX
```

## ethernet/Kconfig
```kconfig
config ENABLE_ETHERNET
    bool "Enable Ethernet"
    depends on !DISABLE_ETHERNET

comment "ETHERNET DISABLE : Chip flash size limit"
    depends on DISABLE_ETHERNET

comment "ETHERNET LIMIT   : Chip flash size limit"
    depends on !DISABLE_ETHERNET && LIMIT_ETHERNET
```

## platform/Kconfig
```kconfig
choice
    prompt "Manufacturer"
config  MANUF_ST
    bool "STMicroelectronics"
endchoice

choice 
    prompt "Chip"
    config  CHIP_STM32F103ZET6
    bool "STM32F103ZET6"
endchoice

source "./Kconfig.in"
```

## platform/STM32F103ZET6/Kconfig.in
```kconfig
config  DISABLE_ETHERNET
    bool 
    default y
    depends on CHIP_STM32F103ZET6

config  LIMIT_SHELL
    bool
    default y
    depends on CHIP_STM32F103ZET6

config  TARGET_ARM
    bool
    default y
    depends on CHIP_STM32F103ZET6

comment "Target architecture : ARM Cortex-M3"
    depends on CHIP_STM32F103ZET6

comment "Flash Start Address : 0x08000000"
    depends on CHIP_STM32F103ZET6

comment "Flash Size          : 512 KB"
    depends on CHIP_STM32F103ZET6

comment "RAM Start Address   : 0x02000000"
    depends on CHIP_STM32F103ZET6

comment "RAM Size            : 64 KB"
    depends on CHIP_STM32F103ZET6
```

## shell/Kconfig
```kconfig
config ENABLE_SHELL
    bool "Enable Shell"
    depends on !DISABLE_SHELL

comment "SHELL DISABLE : Chip flash size limit"
    depends on DISABLE_SHELL

comment "SHELL LIMIT   : Chip flash size limit"
    depends on !DISABLE_SHELL && LIMIT_SHELL
```
